## git_home/linux.git/sourcecode/arch/arm/mach-msm/lge/Kconfig
```kconfig
config MACH_LGE
	bool

menu "LGE Board Selection"
source "arch/arm/mach-msm/lge/Kconfig.board"
endmenu


menu "LGE Specific Patches"

config EARJACK_DEBUGGER
	bool "Earjack UART debugger support"
	depends on MACH_APQ8064_MAKO
	default n
	help
	  Saying Y here will support earjack type UART debugger cable
endmenu
```

## git_home/linux.git/sourcecode/drivers/char/diag/Kconfig
```kconfig
menu "Diag Support"

config DIAG_CHAR
	tristate "char driver interface and diag forwarding to/from modem"
	default m
	depends on USB_G_ANDROID || USB_FUNCTION_DIAG || USB_QCOM_MAEMO
	depends on ARCH_MSM
	help
	 Char driver interface for diag user space and diag-forwarding to modem ARM and back.
	 This enables diagchar for maemo usb gadget or android usb gadget based on config selected.
endmenu

menu "DIAG traffic over USB"

config DIAG_OVER_USB
	bool "Enable DIAG traffic to go over USB"
        depends on ARCH_MSM
	default y
	help
	 This feature helps segregate code required for DIAG traffic to go over USB.
endmenu
```

## git_home/linux.git/sourcecode/drivers/media/video/msm/Kconfig
```kconfig
config MSM_CAMERA_V4L2
        bool "MSM Camera V4L2 Interface"
        depends on MSM_CAMERA
        default n
        ---help---
          This flag enables V4L2 interface of MSM
          camera driver. If enabled, application interacts
          with /dev/video0 through V4L2 APIs. Otherwise,
          native APIs are used through /dev/config0, /dev/frame0,
          and /dev/control0.

comment "Camera Sensor Selection"
config AD5046_ACT
	bool "Lens actuator ad5046"
	depends on MSM_CAMERA && OV5647
	---help---
	  ad5046 lens actuator driver for ov5647.
	  Say Y here if this is msm7627A variant platform.

config IMX074_ACT
	bool "Actuator IMX074 (BAYER 13.5M)"
	depends on MSM_CAMERA
	---help---
	Actuator for SONY 13.5 MP Bayer Sensor

config DW9712_ACT
	bool "Lens actuator dw9721"
	depends on MSM_CAMERA && S5K4E1
	---help---
	  dw9721 lens actuator driver for S5K4E1.
	  Say Y here if this is msm7627A variant platform.

config MSM_CAMERA_FLASH_SC628A
	bool "Qualcomm MSM camera sc628a flash support"
	depends on MSM_CAMERA
	default n
	---help---
	  Enable support for LED flash for msm camera.
	  It is a samtech charge pump flash driver and it
	  supports spotlight and flash light modes with
	  differrent current levels.

config MSM_CAMERA_FLASH_TPS61310
	bool "Qualcomm MSM camera tps61310 flash support"
	depends on MSM_CAMERA
	default n
	---help---
	  Enable support for LED flash for msm camera.
	  It is a Texas Instruments multiple LED Flash
	  for camera flash and video light applications.

config MSM_VPE
	tristate "Qualcomm MSM Video Pre-processing Engine support"
	depends on MSM_CAMERA && (ARCH_MSM7X30 || ARCH_MSM8X60)
	default y
	---help---
	  Enable support for Video Pre-processing Engine

config MSM_CPP
        bool "Qualcomm MSM Camera Post Processing Engine support"
        depends on MSM_CAMERA && MSM_CAMERA_V4L2
        ---help---
          Enable support for Camera Post-processing Engine
          The Post processing engine is capable of scaling
          and cropping image. The driver support V4L2 subdev
          APIs.

config QUP_EXCLUSIVE_TO_CAMERA
	bool "QUP exclusive to camera"
	depends on MSM_CAMERA
	default y
	---help---
	  This flag enabled states that QUP
	  is exclusive to camera. In case this
	  is disabled, the lvs1 voltage is enabled
	  by QUP in the board file as QUP is used by
	  applications other than camera.

config MSM_CSI20_HEADER
        bool "Qualcomm MSM CSI 2.0 Header"
        depends on MSM_CAMERA
        ---help---
          Enable support for CSI drivers to include 2.0
          header. This header has register macros and its
          values and bit mask for register configuration bits
          This config macro is required targets based on 8960,
          8930 and 8064 platforms.

config MSM_CSI30_HEADER
        bool "Qualcomm MSM CSI 3.0 Header"
        depends on MSM_CAMERA
        ---help---
          Enable support for CSI drivers to include 3.0
          header. This header has register macros and its
          values and bit mask for register configuration bits
          This config macro is required for targets based on
          8064 platforms.

config IMX091
        bool "Sensor imx091 (Sony 13MP)"
        depends on MSM_CAMERA
	---help---
	  Sony 13MP sensor back camera that uses 4 mipi lanes,
	  runs at 30 fps preview and 14 fps snapshot
```

## git_home/linux.git/sourcecode/drivers/net/ethernet/msm/Kconfig
```kconfig
#
# msm network device configuration
#

config MSM_RMNET_SMUX
	bool "RMNET SMUX Driver"
	depends on N_SMUX
	help
	  Implements RMNET over SMUX interface.
	  RMNET provides a virtual ethernet interface
	  for routing IP packets within the MSM using
	  HSUART as a physical transport.

config MSM_RMNET_DEBUG
	bool "MSM RMNET debug interface"
	depends on MSM_RMNET
	default n
	help
	  Debug stats on wakeup counts.
```

## git_home/linux.git/sourcecode/drivers/slimbus/Kconfig
```kconfig
#
# SLIMBUS driver configuration
#
menuconfig SLIMBUS
	bool "Slimbus support"
	depends on HAS_IOMEM
	help
	  Slimbus is standard interface between baseband and
	  application processors and peripheral components in mobile
	  terminals.
```

## git_home/linux.git/sourcecode/drivers/thermal/Kconfig
```kconfig
#
# Generic thermal sysfs drivers configuration
#

menuconfig THERMAL
	tristate "Generic Thermal sysfs driver"
	help
	  Generic Thermal Sysfs driver offers a generic mechanism for
	  thermal management. Usually it's made up of one or more thermal
	  zone and cooling device.
	  Each thermal zone contains its own temperature, trip points,
	  cooling devices.
	  All platforms with ACPI thermal support can use this driver.
	  If you want this support, you should say Y or M here.

config THERMAL_HWMON
	bool
	depends on THERMAL
	depends on HWMON=y || HWMON=THERMAL
	default y

config THERMAL_TSENS8960
	tristate "Qualcomm 8960 Tsens Temperature Alarm"
	depends on THERMAL
	help
	  This enables the thermal sysfs driver for the Tsens device. It shows
	  up in Sysfs as a thermal zone with mutiple trip points. Disabling the
	  thermal zone device via the mode file results in disabling the sensor.
	  Also able to set threshold temperature for both hot and cold and update
	  when a threshold is reached.

config THERMAL_MONITOR
	bool "Monitor thermal state and limit CPU Frequency"
	depends on THERMAL_TSENS8960 || THERMAL_TSENS8974
	depends on CPU_FREQ_MSM
	default n
	help
	  This enables thermal monitoring capability in the kernel in the
	  absence of a system wide thermal monitoring entity or until such an
	  entity starts running in the userspace. Monitors TSENS temperature
	  and limits the max frequency of the cores.

config SPEAR_THERMAL
	bool "SPEAr thermal sensor driver"
	depends on THERMAL
	depends on PLAT_SPEAR
	help
	  Enable this to plug the SPEAr thermal sensor driver into the Linux
	  thermal framework
```

## git_home/linux.git/sourcecode/net/bridge/Kconfig
```kconfig
#
# 802.1d Ethernet Bridging
#

config BRIDGE
	tristate "802.1d Ethernet Bridging"
	select LLC
	select STP
	---help---
	  If you say Y here, then your Linux box will be able to act as an
	  Ethernet bridge, which means that the different Ethernet segments it
	  is connected to will appear as one Ethernet to the participants.
	  Several such bridges can work together to create even larger
	  networks of Ethernets using the IEEE 802.1 spanning tree algorithm.
	  As this is a standard, Linux bridges will cooperate properly with
	  other third party bridge products.

	  In order to use the Ethernet bridge, you'll need the bridge
	  configuration tools; see <file:Documentation/networking/bridge.txt>
	  for location. Please read the Bridge mini-HOWTO for more
	  information.

	  If you enable iptables support along with the bridge support then you
	  turn your bridge into a bridging IP firewall.
	  iptables will then see the IP packets being bridged, so you need to
	  take this into account when setting up your firewall rules.
	  Enabling arptables support when bridging will let arptables see
	  bridged ARP traffic in the arptables FORWARD chain.

	  To compile this code as a module, choose M here: the module
	  will be called bridge.

	  If unsure, say N.

config BRIDGE_IGMP_SNOOPING
	bool "IGMP/MLD snooping"
	depends on BRIDGE
	depends on INET
	default y
	---help---
	  If you say Y here, then the Ethernet bridge will be able selectively
	  forward multicast traffic based on IGMP/MLD traffic received from
	  each port.

	  Say N to exclude this support and reduce the binary size.

	  If unsure, say Y.
config DNI_MCAST_TO_UNICAST
	tristate "DNI_MCAST_TO_UNICAST"
	---help---
	  DNI_MCAST_TO_UNICAST
config DNI_MULTI_LAN_SUPPORT
	tristate "DNI_MULTI_LAN_SUPPORT"
	---help---
	  DNI_MULTI_LAN_SUPPORT
config DNI_IPTV_MCAST_TO_UNICAST
	tristate "DNI_IPTV_MCAST_TO_UNICAST"
	depends on DNI_MCAST_TO_UNICAST
	---help---
	  support wireless multicast to unicast in IPTV mode
config BRIDGE_NETGEAR_ACL
	tristate "NETGEAR feature: block a client from accessing the network"
	---help---
	  Block a device according MAC address, If a client is blocked by this function,
	  the DHCP and ARP packet will be passed, other packet to/from local, other port will be dropped

config NTGR_GUEST_NETWORK_DHCP_LEASE
	tristate "NETGEAR feature: dhcp lease time for wireless guest network client is 30 minute"
	---help---
	  Change dhcp lease time for wireless guest network client to 30 minutes
```

## git_home/linux.git/sourcecode/net/offload/Kconfig
```kconfig
#
# offload configuration
#
config NET_OFFLOAD
	bool "Network offload support"
	help
	  Enables QoS based netfilters to provide hooks for re-marking
	  to other system-wide netfilters. Allows for the registration
	  of both DSCP and VLAN re-mark function based on a conntrak.
```

## git_home/linux.git/sourcecode/sound/soc/ipq/Kconfig
```kconfig
#
# Copyright (c) 2013 The Linux Foundation. All rights reserved.
#
# Permission to use, copy, modify, and/or distribute this software for any
# purpose with or without fee is hereby granted, provided that the above
# copyright notice and this permission notice appear in all copies.
#
# THE SOFTWARE IS PROVIDED "AS IS" AND THE AUTHOR DISCLAIMS ALL WARRANTIES
# WITH REGARD TO THIS SOFTWARE INCLUDING ALL IMPLIED WARRANTIES OF
# MERCHANTABILITY AND FITNESS. IN NO EVENT SHALL THE AUTHOR BE LIABLE FOR
# ANY SPECIAL, DIRECT, INDIRECT, OR CONSEQUENTIAL DAMAGES OR ANY DAMAGES
# WHATSOEVER RESULTING FROM LOSS OF USE, DATA OR PROFITS, WHETHER IN AN
# ACTION OF CONTRACT, NEGLIGENCE OR OTHER TORTIOUS ACTION, ARISING OUT OF
# OR IN CONNECTION WITH THE USE OR PERFORMANCE OF THIS SOFTWARE.

config SND_IPQ_SOC
	tristate "SoC Audio for IPQ based platforms"
	depends on ARCH_IPQ806X
	help
	  Say Y or M if you want to add support for IPQ platforms

config SND_IPQ_SOC_IPQ806X
	tristate "SoC Audio support for IPQ806x (Akronite) based platforms"
	depends on ARCH_IPQ806X && SND_IPQ_SOC
	select SND_IPQ_SOC_DMLITE
	select SND_IPQ_SOC_PCM_I2S
	select SND_IPQ_SOC_PCM_SPDIF
	select SND_IPQ_SOC_PCM_VOIP
	select SND_IPQ_SOC_SPDIF
	select SND_IPQ_SOC_LPASS_CODEC
	select SND_IPQ_SOC_CPU_DAI
	select SND_IPQ_SOC_LPAIF
	select SND_IPQ_SOC_CLK
	select SND_IPQ_SOC_PCM_RAW
	help
	  Say Y or M if you want to add support for IPQ platforms

config SND_IPQ_SOC_CLK
	tristate
	depends on SND_IPQ_SOC

config SND_IPQ_SOC_PCM_RAW
	tristate
	depends on SND_IPQ_SOC

config SND_IPQ_SOC_DMLITE
	tristate
	depends on SND_IPQ_SOC

config SND_IPQ_SOC_PCM_I2S
	tristate
	depends on SND_IPQ_SOC

config SND_IPQ_SOC_PCM_SPDIF
	tristate
	depends on SND_IPQ_SOC

config SND_IPQ_SOC_PCM_VOIP
	tristate
	depends on SND_IPQ_SOC

config SND_IPQ_SOC_SPDIF
	tristate
	depends on SND_IPQ_SOC

config SND_IPQ_SOC_LPASS_CODEC
	tristate
	depends on SND_IPQ_SOC

config SND_IPQ_SOC_CPU_DAI
	tristate
	depends on SND_IPQ_SOC

config SND_IPQ_SOC_LPAIF
	tristate
	depends on SND_IPQ_SOC
```

## package/dnsmasq/Config.in
```kconfig
config DNSMASQ_GIT_TREEISH
	string
	prompt "treeish of dnsmasq git repository"
	default "HEAD"
	help
	  input the treeish of dnsmasq git repository which you want to build

config DNSMASQ_SUP_PARENTAL_CTL
	bool "support Parental Control feature"
	default n
	help
	  If Parental Control is enabled, any dns query will be sent to 208.67.222.222 or 208.67.202.202

	  If unsure, say N.

config DNSMASQ_SUP_STATIC_PPTP
	bool "support static pptp for Russian Version"
	default n
	help
	  If unsure, say N.

config DNSMASQ_SUP_USBSHARE_DOMAIN
	bool "support USB share domain"
	default n
	help
	  dnsmasq will resolve "readyshare.routerlogin.net" and "readyshare.routerlogin.com" to Router LAN IP if this option is enabled.
	  Say Y if your produce support USB

	  If unsure, say N.

config DNSMASQ_SUP_IPV6_FEATURE
	bool "support request of DNS with IPv6"
	default n
	help
	  Router will accept DNS query from LAN interface with IPv6 source, and DNS server could be also IPv6.

	  If unsure, say N.

config DNSMASQ_BIND_SRVSOCK_TO_WAN
	bool "bind server socket to WAN interface"
	default n
	help
	  The query will only be forwarded to WAN interface if this option is enabled.
	  Recommend to say Y if your enabled "support request of DNS with IPv6" option.

	  If unsure, say N.

config DNSMASQ_START_WHEN_BOOT_UP
	bool "start dnsmasq when system boot up"
	default n
	help
	  Say Y if your net-wan script does not call "/etc/init.d/dnsmasq start".

	  If unsure, say N.
```

## package/green-download/Config.in
```kconfig
config GREENDOWNLOAD_GIT_TREEISH
	string
	prompt "treeish of greendownload git repository"
	default "greendownload-1.0-dni5"
	help
           Input the treeish of greendownload git repository which you want to build

config GREENDOWNLOAD_GIT_REPOSITORY
	string
	prompt "name of greendownload git repository"
	default "greendownload.git"
	help
	   Input the name of greendownload git repository which you want to build

config GREENDOWNLOAD_GIT_URL
	string
	prompt "url of greendownload git repository"
	default "ssh://dniserver/scm/dnigit/common/apps/greendownload.git"
	help
	   Input the url of greendownload git repository which you want to build


config TRAFFICMETER_PLATFORM_PATCH
	bool "Apply platform specific patch"
	default n
```

## package/libcurl/Config.in
```kconfig
config DNI_GREEN_DOWNLOAD
	bool "support DNI Green download"
	default n
	help
	  If DNI Green download was enabled, could set this config.

	  If unsure, say N.
```

## package/minidlna/Config.in
```kconfig
config MINIDLNA_GIT_TREEISH
	string
	prompt "treeish of minidlna git repository"
	default "HEAD"
	help
	  input the treeish of minidlna git repository which you want to build

config MINIDLNA_MODELNAME
	string
	prompt "Model name of the UPnP MediaServer in router"
	default "Windows Media Connect compatible (ReadyDLNA)"
	help
	  Model name of the UPnP MediaServer in router, such as "Windows Media Connect compatible (NETGEAR WNDR3800)"
```
