## package/miniupnpd/Config.in
```kconfig
config MINIUPNPD_GIT_TREEISH
	string
	prompt "treeish of miniupnpd git repository"
	default "HEAD"
	help
	  input the treeish of miniupnpd git repository which you want to build

config MINIUPNPD_FRIENDLYNAME
	string
	prompt "Friendly name of the router"
	default "NETGEAR WPN824N Wireless Router"
	help
	  Friendly name of the router, such as NETGEAR WPN824N Wireless Router

config MINIUPNPD_MODELNAME
	string
	prompt "Model name of the router"
	default "RangeMax N150 Wireless Router"
	help
	  Model name of the router, such as RangeMax N150 Wireless Router

config MINIUPNPD_MODELNUMBER
	string
	prompt "Model number of the router"
	default "WPN824N"
	help
	  Model number of the router, such as WPN824N

config MINIUPNPD_MODELURL
	string
	prompt "Model url of the router"
	default "http://www.netgear.com/home/products/wirelessrouters"
	help
	  Model url of the router, such as http://www.netgear.com/home/products/wirelessrouters/simplesharing/WPN824N.aspx

config MINIUPNPD_SUPPORT_PNPX
	bool "Support Microsoft PnP-X function"
	default n
	help
	  Under Windows Vista and Windows 7, Plug and Play Extensions (PnP-X) allows network-connected
	  devices to be discovered and installed on a PC client as if they were connected physically.
	  URL: http://www.microsoft.com/whdc/connect/rally/rallypnpx.mspx

	  If unsure, say N.

config MINIUPNPD_PNPX_HWID
	depends on MINIUPNPD_SUPPORT_PNPX
	string
	prompt "PnP-X HW ID"
	default "VEN_01f2&DEV_8000&REV_01 VEN_0033&DEV_0008&REV_01"
	help
	  For NETGEAR Router, the PnP-X HW ID have 3 parts: [NTGR Specific HW ID] [NTGR Generic HW ID] VEN_0033&DEV_0008&REV_01
	  thereinto, [NTGR Specific HW ID] is assigned by NTGR and each ID is used specifically for a specific model.
	  [NTGR Generic HW ID] For a router product without a USB port, use VEN_01f2&DEV_8000&REV_01; for a router product with
	  a USB port, use VEN_01f2&DEV_8000&SUBSYS_01&REV_01 VEN_01f2&DEV_8000&REV_01.
	  VEN_0033&DEV_0008&REV_01 is Microsoft Specific HW ID for IGD

config MINIUPNPD_PATCH_GEN_UUID
	bool "Apply patch to generate UUID according MAC Address"
	default n
	help
	  Say Y if you want to generate UUID according MAC Address

	  If unsure, say N.

config WAN_IFNAME
	string
	prompt "wan interface name"
	default "brwan"
	help
	  the name of wan interface 

config MINIUPNPD_DEVUPC
	string
	prompt "universal product code"
	help
	  "MINIUPNPD configuration with universal product code"
```

## package/ppp-nas/Config.in
```kconfig
config PPP_NAS_GIT_TREEISH
	string
	prompt "treeish of ppp-nas git repository"
	default "HEAD"
	help
	  input the treeish of ppp-nas git repository which you want to build
```

## package/qca-wifi/Config.in
```kconfig
menu "Configuration"
	depends on PACKAGE_kmod-qca-wifi

config QCA_WIFI_USE_DNI_GIT
	bool "Use DNI git reporitory"
	default n

config QCA_WIFI_USE_CLIENT_BRIDGE
	bool "Use client bridge feature"
	default n

config QCA_WIFI_DISPLAY_SCAN_IN_PROC
	bool "Display scan result in proc system"
	default n

endmenu
```

## package/qsdk-wifi-script/Config.in
```kconfig
# QSDK WIFI SCRIPT configuration

menu "Configuration"

config QSDK_WIFI_SCRIPT_GIT_REPOSITORY
	string "Repository name of qsdk wifi script"
	default ""
	help
	  Specify the git repository name of qsdk wifi script, should be the foler name in
	  git_home path.

config QSDK_WIFI_SCRIPT_GIT_URL
	string "URL of sqdk wifi script in remote server"
	default ""
	help
	  Should be the URL to indentify repository path in dniserver.

config QSDK_WIFI_SCRIPT_GIT_TREEISH
	string "Which tag used on the git repository"
	default ""

endmenu
```

## package/udhcp/Config.in
```kconfig
config UDHCP_GIT_TREEISH
	string
	prompt "treeish of udhcp git repository"
	default "HEAD"
	help
	  input the treeish of udhcp git repository which you want to build

config UDHCP_DHCPD_STATIC_LEASE
	bool "Support fixed IP settings via editing the Address Reservation Table to specific clients"
	default y
	help
	  Netgear router spec V1.6 4.1 : Netgear router SHOULD support fixed IP
	  settings via editing the Address Reservation Table to specific clients

	  If unsure, say N.

config UDHCP_DHCPD_SHOW_HOSTNAME
	bool "List all DHCP clients host names for showing attached devices name if unknown by 'net-scan'"
	default y
	help
	  The name of the connected PC can't be got by NETBIOS query sometimes,
	  and the PC host name is sent in DHCP Request packet, list all DHCP clients
	  host names for showing attached devices name if unknown by 'net-scan'.

	  If unsure, say N.

config UDHCP_WAN_LAN_IPCONFLICT
	bool "Do IP conflict detection when wan port in dhcp client mode get ip"
	default y
	help
	  Netgear router spec V1.6 4.4 WAN/LAN IP conflict detection.
	  when wan port in dhcp client mode get ip, do IP conflict detection

	  If unsure, say N.

config UDHCP_IP_CONFLICT_CMD
	depends on UDHCP_WAN_LAN_IPCONFLICT
	string
	prompt "Specify your own ipconflict command"
	default "/sbin/ipconflict"
	help
	  define your own ipconflict command, it may defined at package/net-util
	  Manufacturer URL of UPnP root device

config UDHCP_RFC3442_121_SUPPORT
	bool "Support option 121 (RFC 3442) in dhcpc"
	default y
	help
	  NETGEAR router spec V1.6, chapter 5.1 Classless Route Option support in dhcpc
	  option 121 (RFC 3442)

	  If unsure, say N.

config UDHCP_RFC2132_33_SUPPORT
	bool "Support option 33 (RFC 2132) in dhcpc"
	default y
	help
	  NETGEAR router spec V1.6, chapter 5.1 Classless Route Option support in dhcpc
	  option 33 (RFC 2132) support

	  If unsure, say N.

config UDHCP_RFC3442_249_SUPPORT
        bool "Support option 249 (RFC 3442) in dhcpc"
        default y
        help
          NETGEAR router spec V2.0, chapter 5.1 Classless Route Option support in dhcpc
          option 249 (RFC 3442)

          If unsure, say N.

config UDHCP_DHCPD_CHECK_SERVER_IP
	bool "Check whether the request IP is the same with sever's IP"
	default y
	help
	  check whether the request IP is the same with sever's IP

	  If unsure, say N.

config UDHCP_SUPPORT_OPTION_60
	bool "Support changing the Vendor ID by \"-V [YOU_ID]\" in dhcpc"
	default y
	help
	  NETGEAR Router Spec V1.8, chapter 16.2.3 TR-69
	  If TR_069 function is enabled, and the WAN type is DHCP mode, then the CPE should
	  include the string "dslforum.org"(all lower case) any where in the Vendor Class
	  Identifier (DHCP option 60) to let DHCP server to identify this device as supporting
	  this method ......
	  ...

	  If selected, udhcpc can change the Vendor ID by "-V [YOU_ID]"

	  If unsure, say N.

config UDHCP_SUPPORT_OPTION_43
	bool "Obtain the parameter ManagementServer.URL in option 43 and recognize it as ACS URL address and query it IP address via DNS again"
	default y
	help
	  NETGEAR Router Spec V1.8, chapter 16.2.3 TR-69
	  ...
	  and obtain the parameter ManagementServer.URL in option 43 and recognize it as ACS URL
	  address and query it IP address via DNS again

	  If unsure, say N.

config UDHCP_DHCPC_CHOOSE_OLDIP
	bool "The client may choose to wait for multiple responses, like to select the information including old IP address, DNS primary & secondary, gateway address"
	default y
	help
	  NETGEAR router spec V1.8,chapter 5.1 Classless Route Option support in dhcpc
	  The client receives one or more DHCP OFFER messages from one or more servers.
	  The client may choose to wait for multiple responses,like to select the information
	  including old IP address,DNS primary & secondary,gateway address,The waiting time
	  is 1 second,For the first time to get an address after the router reboots,there is no
	  preference.

	  If unsure, say N.

config UDHCP_DHCP_PACKET_RESIZE
	bool "Dynamic resize the DHCP packet according to it's real payload size and make sure their size are not larger than 576 octets before send out"
	default y
	help
	  In RFC2131, Page.9-10,
	  ...
	  The 'options' field is now variable length. A DHCP client must be
	  prepared to receive DHCP messages with an 'options' field of at least
	  length 312 octets.  This requirement implies that a DHCP client must
	  be prepared to receive a message of up to 576 octets, the minimum IP
	  datagram size an IP host must be prepared to accept [3].  ...
	  ...

	  Some DHCP server will send a packet larger than 576 octets(which include IP,
	  UDP header, not include Ethernet header), but the 'struct udp_dhcp_packet'
	  size is 576 in udhcp code. If we simple enlarge the option buffer size, the
	  packet which is larger than 576 octets can be received. It seems fixed this
	  bugs, but cause another defect, that the dhcp packets which router send are
	  larger than 576 octets also, which makes many DHCP server can't handle the
	  larger DHCP packet and lead to DHCP process fail if using DHCP type to get
	  WAN IP.

	  Consider the packet size of almost all of DHCP packet Router send is less
	  than 576 octets, so we can dynamic resize the DHCP packet according to it's
	  real payload size and make sure their size are not larger than 576 octets
	  before send out.

	  If unsure, say N.

config UDHCP_PATCH_DHCPC_TIMEOUT
	bool "Apply patch to change the udhcp client time out value"
	default n
	help
	  The udhcp client will send DHCP discovery packet every 300 seconds if no response packet received.
	  If you apply this patch, the udhcp client will send DHCP discovery packet every 60 seconds in first 3 times,
	  then send discovery packet every 300 seconds if no response packet received still.

	  If unsure, say N.

config UDHCP_PATCH_DHCPD_CHECK_WAN
	bool "Apply patch to check whether WAN cable is plugged before sending discover packet"
	default n
	help
	  [NETGEAR Lancelot.Wang]: Before sending discover packet, should check whether WAN cable is plugged.
	  If WAN cable is not plugged, the discovery packet should not be sent.

	  If unsure, say N.

config UDHCP_PATCH_DHCPC_GET_ACSURL
	bool "Apply patch to save ACS URL that got from DHCP server."
	default n
	help
	  ACS URL of TR-069 feature could be got from DHCP server, we must save it when get successful.

	  If unsure, say N.
```

## package/wlan-common/Config.in
```kconfig
config WLAN_COMMON_GIT_TREEISH
	string
	prompt "treeish of wlan-common git repository"
	default "edc0e48444349ce395b3343988d441595cf4ffdb"
	help
           Input the treeish of wlan-common git repository which you want to build

config WLAN_COMMON_GIT_REPOSITORY
	string
	prompt "name of wlan-common git repository"
	default "wlan-common.git"
	help
	   Input the name of wlan-common git repository which you want to build

config WLAN_COMMON_GIT_URL
	string
	prompt "url of wlan-common git repository"
	default "ssh://dniserver/scm/dnigit/apps/wlan-common/spencer/wlan-common.git"
	help
	   Input the url of wlan-common git repository which you want to build
```

## target/linux/ar71xx/files/sound/soc/ath79/Kconfig
```kconfig
#
# Copyright (c) 2013 The Linux Foundation. All rights reserved.
#
# Permission to use, copy, modify, and/or distribute this software for any
# purpose with or without fee is hereby granted, provided that the above
# copyright notice and this permission notice appear in all copies.
#
# THE SOFTWARE IS PROVIDED "AS IS" AND THE AUTHOR DISCLAIMS ALL WARRANTIES
# WITH REGARD TO THIS SOFTWARE INCLUDING ALL IMPLIED WARRANTIES OF
# MERCHANTABILITY AND FITNESS. IN NO EVENT SHALL THE AUTHOR BE LIABLE FOR
# ANY SPECIAL, DIRECT, INDIRECT, OR CONSEQUENTIAL DAMAGES OR ANY DAMAGES
# WHATSOEVER RESULTING FROM LOSS OF USE, DATA OR PROFITS, WHETHER IN AN
# ACTION OF CONTRACT, NEGLIGENCE OR OTHER TORTIOUS ACTION, ARISING OUT OF
# OR IN CONNECTION WITH THE USE OR PERFORMANCE OF THIS SOFTWARE.

config SND_ATH79_SOC
	tristate "SoC Audio for ath79"
	depends on SOC_AR934X
	help
	  Say Y or M if you want to add support for ath79 platforms
	  You will also need to select the board in the options below.

config SND_ATH79_SOC_I2S
	tristate

config SND_ATH79_SOC_CODEC
	tristate

config SND_ATH79_SOC_DB120
	tristate "SoC Audio support for QCA Reference design DB120"
	depends on SND_ATH79_SOC
	select SND_ATH79_SOC_I2S
	select SND_ATH79_SOC_CODEC
	help
	  Say Y if you want to add support for SoC audio on DB120
	  Qualcomm-Atheros reference design. This option enables the
	  DB12x machine support, ath79 PCM engine, I2S interface and internal
	  codec.

config SND_ATH79_SOC_CUS227
	tristate "SoC  Audio support for CUS227 board"
	depends on SND_ATH79_SOC
	select SND_ATH79_SOC_I2S
	select SND_SOC_WM8988
	help
	  Say Y if you want to add support for SoC audio on DB120
	  Qualcomm-Atheros reference design. This option enables the
	  CUS227 machine support, ath79 PCM engine, I2S interface and internal
	  codec.
```

## target/linux/ipq806x/image/sysupgrade-squashfs.its
```
/dts-v1/;

/ {
        description = "IPQ8066/NOR Sysupgrade image";
        images {

                kernel {
                        description = "openwrt-ipq806x-3.4-uImage";
                        data = /incbin/("./openwrt-ipq806x-3.4-uImage");
                        type = "firmware";
                        arch = "arm";
                        compression = "none";
                        hash@1 { algo = "crc32"; };
                };

                fs {
                        description = "openwrt-ipq806x-squashfs-root.img";
                        data = /incbin/("./openwrt-ipq806x-squashfs-root.img");
                        type = "firmware";
                        arch = "arm";
                        compression = "none";
                        hash@1 { algo = "crc32"; };
                };

        };
};
```

## target/linux/ipq806x/image/sysupgrade-ubi.its
```
/dts-v1/;

/ {
        description = "IPQ8066/NAND Sysupgrade image";
        images {

                fs {
                        description = "openwrt-ipq806x-ubi-root.img";
                        data = /incbin/("./openwrt-ipq806x-ubi-root.img");
                        type = "firmware";
                        arch = "arm";
                        compression = "none";
                        hash@1 { algo = "crc32"; };
                };

        };
};
```
